## config/boards/shields/dactyl_cc/Kconfig.defconfig
```kconfig
if SHIELD_DACTYL_CC_LEFT

    config ZMK_KEYBOARD_NAME
        default "Dactyl CC"

    config ZMK_SPLIT_BLE_ROLE_CENTRAL
        default y

endif

if SHIELD_DACTYL_CC_RIGHT

    config ZMK_KEYBOARD_NAME
        default "Dactyl CC Right"

endif

if SHIELD_DACTYL_CC_LEFT || SHIELD_DACTYL_CC_RIGHT

    config ZMK_SPLIT
        default y

endif

if LVGL

config LVGL_HOR_RES_MAX
	default 128

config LVGL_VER_RES_MAX
	default 32

config LVGL_VDB_SIZE
	default 64

config LVGL_DPI
	default 148

config LVGL_BITS_PER_PIXEL
	default 1

choice LVGL_COLOR_DEPTH
	default LVGL_COLOR_DEPTH_1
endchoice

endif # LVGL
```
